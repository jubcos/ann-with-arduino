#include <Adafruit_GFX.h>
#include <MCUFRIEND_kbv.h>
#include <TouchScreen.h>

const int MAX = 8;

// Neural Network parameters
const int input_neurons = 64;
const int hidden_neurons = 24;
const int output_neurons = 5;
float weights_input_hidden[64][24] = {
  {0.186531, 0.218133, 0.020380, 0.015651, 0.243905, -0.021037, 0.092124, 0.069918, -0.017730, -0.196944, 0.229855, 0.154664, 0.208664, 0.057177, -0.047315, 0.089452, 0.259969, 0.226403, -0.022485, 0.151099, -0.028551, 0.215435, -0.197585, -0.063052},
  {-0.423306, 0.081864, -0.065731, 0.151415, -0.008330, 0.080685, -0.181784, -0.097402, 0.190220, -0.202960, 0.041278, -0.300651, 0.042906, 0.326183, 0.043645, -0.300085, 0.298023, -0.280583, -0.044109, -0.063145, -0.239702, 0.517276, -0.082413, 0.026851},
  {0.109423, -0.200112, 0.235206, 0.024584, -0.389330, -0.263284, 0.167171, -0.142618, -0.044970, 0.114896, -0.060405, 0.079099, 0.144773, 0.018291, 0.044280, 0.008822, -0.043866, -0.398906, 0.157408, -0.358522, -0.227417, 0.007754, -0.487601, -0.296731},
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  {0.331059, 0.121038, -0.087337, 0.090800, -0.273387, -0.073177, -0.448430, 0.145275, -0.168383, -0.324012, 0.383168, -0.173609, -0.137221, -0.053943, -0.080905, 0.564650, 0.271393, 0.179077, 0.401483, 0.215822, -0.013391, -0.358457, 0.058644, -0.357326}
};




float bias_hidden[] = {0.093412, 0.000000, 0.110464, 0.008775, 0.068233, 0.082116, 0.104829, 0.098776, 0.000000, 0.118286, 0.027991, 0.081256, 0.059798, 0.122816, -0.019340, 0.059847, -0.011057, 0.040207, 0.047419, 0.089125, 0.006612, 0.076701, 0.143901, 0.093954};


float weights_hidden_output[24][5] = {
  {-0.171729, 0.156012, -0.425968, -0.234150, 0.555531},
  {-0.122233, 0.288771, 0.440929, 0.446183, -0.076586},
  {-0.757646, 0.446137, 0.476637, 0.192236, 0.492440},
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  {0.572050, -0.344911, -0.421894, -0.310120, 0.347194}
};



float bias_output[] = {-0.074635, 0.077108, -0.067240, 0.058395, 0.007740};



// TFT display and touch screen setup
MCUFRIEND_kbv tft;
#define LCD_CS A3 // Chip Select goes to Analog 3
#define LCD_CD A2 // Command/Data goes to Analog 2
#define LCD_WR A1 // LCD Write goes to Analog 1
#define LCD_RD A0 // LCD Read goes to Analog 0
#define LCD_RESET A4 // Can alternately just connect to Arduino's reset pin

// Assign human-readable names to some common 16-bit color values:
#define BLACK   0x0000
#define WHITE   0xFFFF

// Touchscreen pins, obtained from the shield
#define YP A1  // must be an analog pin, use "An" notation!
#define XM A2  // must be an analog pin, use "An" notation!
#define YM 7   // can be a digital pin
#define XP 6   // can be a digital pin

// Use your calibration values
#define TS_MINX 141
#define TS_MAXX 943
#define TS_MINY 165
#define TS_MAXY 835

TouchScreen ts = TouchScreen(XP, YP, XM, YM, 300);

#define GRID_SIZE 8
#define CELL_SIZE 30

#define TOUCH_DELAY 75
#define BUTTON_DELAY 500

int grid[GRID_SIZE][GRID_SIZE] = {0};
unsigned long lastTouchTime = 0;
unsigned long lastButtonTime = 0;

char prediction[20];

void setup() {
  Serial.begin(9600);
  uint16_t identifier = tft.readID();
  tft.begin(identifier);
  tft.setRotation(1);
  tft.fillScreen(BLACK);
  tft.fillRect(250, 30, 60, 60, WHITE);

  drawGrid();
}

void loop() {
  unsigned long currentTime = millis();

  TSPoint p = ts.getPoint();
  if (p.z > ts.pressureThreshhold && (currentTime - lastTouchTime > TOUCH_DELAY)) {
    lastTouchTime = currentTime;

    pinMode(XM, OUTPUT);
    pinMode(YP, OUTPUT);

    int16_t mappedX = map(p.x, TS_MINX, TS_MAXX, tft.width(), 0); // Correct mirroring by swapping map range
    int16_t mappedY = map(p.y, TS_MINY, TS_MAXY, 0, tft.height());

    if (mappedX >= 0 && mappedX < GRID_SIZE * CELL_SIZE && mappedY >= 0 && mappedY < GRID_SIZE * CELL_SIZE) {
      int col = mappedX / CELL_SIZE;
      int row = mappedY / CELL_SIZE;

      grid[row][col] = !grid[row][col]; // Toggle cell state
      fillCell(row, col, grid[row][col] ? WHITE : BLACK);
    }

    // Check if the touch is within the button area
    if (mappedX >= 250 && mappedX <= 310 && mappedY >= 30 && mappedY <= 90 && (currentTime - lastButtonTime > BUTTON_DELAY)) {
      lastButtonTime = currentTime;
      performANNPrediction();

      tft.drawRect(250, 30, 60, 60, WHITE);
      tft.fillRect(251, 31, 58, 58, BLACK);
      delay(50);
      tft.fillRect(250, 30, 60, 60, WHITE);
    }

    // Display the prediction
    tft.fillRect(245, 175, 100, 30, BLACK);
    tft.setCursor(245, 175);
    tft.setTextColor(WHITE);
    tft.setTextSize(4);
    tft.print(prediction);
  }
}

void drawGrid() {
  tft.drawRect(0, 0, GRID_SIZE * CELL_SIZE, GRID_SIZE * CELL_SIZE, WHITE);
  for (int i = 1; i < GRID_SIZE; i++) {
    tft.drawFastHLine(0, i * CELL_SIZE, GRID_SIZE * CELL_SIZE, WHITE);
    tft.drawFastVLine(i * CELL_SIZE, 0, GRID_SIZE * CELL_SIZE, WHITE);
  }
}

void fillCell(int row, int col, uint16_t color) {
  tft.fillRect(col * CELL_SIZE + 1, row * CELL_SIZE + 1, CELL_SIZE - 1, CELL_SIZE - 1, color);
}

void performANNPrediction() {
  Serial.println("Grid State:");
  uint8_t input[64];
  for (int row = 0; row < GRID_SIZE; row++) {
    for (int col = 0; col < GRID_SIZE; col++) {
      input[row * GRID_SIZE + col] = grid[row][col];
      Serial.print(grid[row][col]);
      if (col < GRID_SIZE - 1) Serial.print(", ");
    }
    Serial.println();
  }

  float hidden[hidden_neurons];
  float output[output_neurons];
  forward(input, hidden, output);

  int predicted_digit = 0;
  float max_val = output[0];
  for (int j = 1; j < output_neurons; j++) {
    if (output[j] > max_val) {
      max_val = output[j];
      predicted_digit = j;
    }
  }

  snprintf(prediction, sizeof(prediction), "(%d)", predicted_digit);

  Serial.print("Prediction: ");
  Serial.println(prediction);
}

float relu(float x) {
  return x > 0 ? x : 0;
}

void softmax(float input[], float output[], int length) {
  float max_val = input[0];
  for (int i = 1; i < length; i++) {
    if (input[i] > max_val) {
      max_val = input[i];
    }
  }

  float sum = 0.0;
  for (int i = 0; i < length; i++) {
    output[i] = exp(input[i] - max_val);
    sum += output[i];
  }

  for (int i = 0; i < length; i++) {
    output[i] /= sum;
  }
}

void forward(const uint8_t input[], float hidden[], float output[]) {
  for (int i = 0; i < hidden_neurons; i++) {
    hidden[i] = 0.0;
    for (int j = 0; j < input_neurons; j++) {
      hidden[i] += input[j] * weights_input_hidden[j][i];
    }
    hidden[i] += bias_hidden[i];
    hidden[i] = relu(hidden[i]);
  }

  for (int i = 0; i < output_neurons; i++) {
    output[i] = 0.0;
    for (int j = 0; j < hidden_neurons; j++) {
      output[i] += hidden[j] * weights_hidden_output[j][i];
    }
    output[i] += bias_output[i];
  }

  softmax(output, output, output_neurons);
}
